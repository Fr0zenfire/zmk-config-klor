## config/west.yml
```yaml
manifest:
  remotes:
    - name: zmkfirmware
      url-base: https://github.com/zmkfirmware
    - name: Fr0zenfire
      url-base: https://github.com/Fr0zenfire
  projects:
    - name: zmk
      remote: zmkfirmware
      revision: main
      import: app/west.yml
    - name: prospector-zmk-module                 
      remote: Fr0zenfire                         
      revision: feat/operator-custom
  self:
    path: config
```
